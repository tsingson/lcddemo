/*********************************************
*****************2.0寸  7PIN SPI TFT FOR STM32F103*************
*****STM32F103驱动**************************
***** PB5----3  SCK   ,  PB6----4  SDA   ,    PB7---5  RST   ,
      PB8    ---6   DC   ,    PB9 ----7   CS
***** BY:GU 
*********ST7789V2

从左往右，从上往下    240*320  18bit 6 6 6 RGB 模式  高位模式
********************************************************/
#include "stm32f10x.h"

#define OLED_COLUMN_NUMBER 240
#define OLED_LINE_NUMBER 320
#define OLED_COLUMN_OFFSET 0

#define RED 	0XFF0000
#define GREEN  	0X00FF00
#define BLUE 	0X0000FF

/**********SPI引脚分配，连接oled屏，更具实际情况修改*********/

#define SPI_SCK_0  GPIOB->BRR=0X0020       // 设置sck接口到PB5   清零
#define SPI_SCK_1  GPIOB->BSRR=0X0020       //置位
#define SPI_SDA_0  GPIOB->BRR=0X0040       // 设置SDA接口到PB6
#define SPI_SDA_1  GPIOB->BSRR=0X0040
#define SPI_RST_0  GPIOB->BRR=0X0080       // 设置RST接口到PB7
#define SPI_RST_1  GPIOB->BSRR=0X0080
#define SPI_DC_0   GPIOB->BRR=0X0100      // 设置DC接口到PB8
#define SPI_DC_1   GPIOB->BSRR=0X0100
#define SPI_CS_0   GPIOB->BRR=0X0200    // 设置CS接口到PB9
#define SPI_CS_1   GPIOB->BSRR=0X0200

const unsigned char  picture_tab[]={
//水平扫描18bit  100*100
0X00,0X80,0XF4,0X00,0X80,0XF4,0X00,0X80,0XF4,0X00,0X80,0XF4,0X00,0X80,0XF4,0X00,
0X80,0XF4,0X00,0X80,0XF4,0X00,0X80,0XF4,0X00,0X80,0XF4,0X00,0X80,0XF4,0X00,0X80,
0XF4,0X00,0X80,0XF4,0X00,0X80,0XF4,0X00,0X80,0XF4,0X00,0X80,0XF4,0X00,0X80,0XF4,
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0X28,0X08,0X18,0X2C,0X68,0X5C,0X84,0X74,0X64,0X8C,0X58,0X48,0X70,0X28,0X1C,0X44,
};
const unsigned char china_char[][32]=   		//
{
{0x00,0x00,0xE4,0x3F,0x28,0x20,0x28,0x25,0x81,0x08,0x42,0x10,0x02,0x02,0x08,0x02,
0xE8,0x3F,0x04,0x02,0x07,0x07,0x84,0x0A,0x44,0x12,0x34,0x62,0x04,0x02,0x00,0x02},/*"深",0*/
{0x88,0x20,0x88,0x24,0x88,0x24,0x88,0x24,0x88,0x24,0xBF,0x24,0x88,0x24,0x88,0x24,
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0x80,0x00,0x88,0x08,0x88,0x10,0x84,0x20,0x82,0x40,0x81,0x40,0xA0,0x00,0x40,0x00},/*"示",10*/


};
const unsigned char  *point;

void SYS_init(unsigned char PLL)
{
	
		 
	RCC->APB1RSTR = 0x00000000;//复位结束			 
	RCC->APB2RSTR = 0x00000000; 	  
  	RCC->AHBENR = 0x00000014;  //睡眠模式闪存和SRAM时钟使能.其他关闭.	  
  	RCC->APB2ENR = 0x00000000; //外设时钟关闭.			   
  	RCC->APB1ENR = 0x00000000;   
	RCC->CR |= 0x00000001;     //使能内部高速时钟HSION
	
	RCC->CFGR &= 0xF8FF0000;   //复位SW[1:0],HPRE[3:0],PPRE1[2:0],PPRE2[2:0],ADCPRE[1:0],MCO[2:0]					 
	RCC->CR &= 0xFEF6FFFF;     //复位HSEON,CSSON,PLLON
	RCC->CR &= 0xFFFBFFFF;     //复位HSEBYP	   	  
	RCC->CFGR &= 0xFF80FFFF;   //复位PLLSRC, PLLXTPRE, PLLMUL[3:0] and USBPRE
	while(((RCC->CFGR>>2)& 0x03 )!=0x00); 	
	RCC->CIR = 0x00000000;     //关闭所有中断		 
	//配置向量表				  
  
//	SCB->VTOR = 0x08000000|(0x0 & (u32)0x1FFFFF80);//设置NVIC的向量表偏移寄存器
	
 	RCC->CR|=0x00010000;  //外部高速时钟使能HSEON
	while(((RCC->CR>>17)&0x00000001)==0);//等待外部时钟就绪
	RCC->CFGR=0X00000400; //APB1=DIV2;APB2=DIV1;AHB=DIV1;
	PLL-=2;//抵消2个单位
	RCC->CFGR|=PLL<<18;   //设置PLL值 2~16
	RCC->CFGR|=1<<16;	  //PLLSRC ON 
	

	RCC->CR|=0x01000000;  //PLLON
	while(!(RCC->CR>>25));//等待PLL锁定
	RCC->CFGR|=0x00000002;//PLL作为系统时钟	 
	while(((RCC->CFGR>>2)&0x03)!=0x02);   //等待PLL作为系统时钟设置成功
	
	
}

void IO_init(void)
{
	RCC->APB2ENR|=1<<3;    //使能PORTB时钟 
	GPIOB->CRL&=0X000FFFFF;				//将B567口配置为通用推挽输出,最大50MH
	GPIOB->CRL|=0X33300000;				
	GPIOB->CRH&=0XFFFFFF00;				//将B89口配置为通用推挽输出,最大50MH
	GPIOB->CRH|=0X00000033;
	GPIOB->ODR=0XFFFF;
}
void delay_us(unsigned int _us_time)
{       
  unsigned char x=0;
  for(;_us_time>0;_us_time--)
  {
    x++;x++;x++;x++;x++;x++;x++;x++;x++;x++;x++;x++;
	  x++;x++;x++;x++;x++;x++;x++;x++;x++;x++;x++;x++;
  }
}
void delay_ms(unsigned int _ms_time)
  {
    unsigned int i,j;
    for(i=0;i<_ms_time;i++)
    {
    for(j=0;j<900;j++)
      {;}
    }
  }
/*************SPI配置函数*******************
SSD1306，SCL空闲时低电平，第一个上升沿采样
模拟SPI
******************************************/

/**************************SPI模块发送函数************************************************

 *************************************************************************/
void SPI_SendByte(unsigned char byte)
{
  
  unsigned char counter;
   
  for(counter=0;counter<8;counter++)
  { 
    SPI_SCK_0;
	  
    if((byte&0x80)==0)
    {
      SPI_SDA_0;
    }
    else SPI_SDA_1;
    byte=byte<<1;
	
    SPI_SCK_1;	
	
	SPI_SCK_0;
		
  } 
}

void TFT_SEND_CMD(unsigned char o_command)
  {
    SPI_DC_0;
    SPI_CS_0;
    SPI_SendByte(o_command);
    SPI_CS_1;
	 
    //SPI_DC_1;
  }
void TFT_SEND_DATA(unsigned char o_data)
  { 
    SPI_DC_1;
    SPI_CS_0;
    SPI_SendByte(o_data);
    SPI_CS_1;
	  
   }
void OLED_clear(void)
  {
    unsigned int ROW,column;
	TFT_SEND_CMD(0x2a); 		//Column address set
	TFT_SEND_DATA(0x00); 		//start column
	TFT_SEND_DATA(0x00); 
	TFT_SEND_DATA(0x00);		//end column
	TFT_SEND_DATA(0xEF);

	TFT_SEND_CMD(0x2b); 		//Row address set
	TFT_SEND_DATA(0x00); 		//start row
	TFT_SEND_DATA(0x00); 
	TFT_SEND_DATA(0x01);		//end row
	TFT_SEND_DATA(0x3F);
	  TFT_SEND_CMD(0x2C);			//Memory write
    for(ROW=0;ROW<OLED_LINE_NUMBER;ROW++)             //ROW loop
      { 
	  
          for(column=0;column<OLED_COLUMN_NUMBER;column++)	//column loop
            {
              TFT_SEND_DATA(0x00);
			  TFT_SEND_DATA(0x00);
				TFT_SEND_DATA(0x00);
            }
      }
  }
void OLED_full(unsigned long color)
  {
    unsigned int ROW,column;
	  TFT_SEND_CMD(0x2a); 		//Column address set
	TFT_SEND_DATA(0x00); 		//start column
	TFT_SEND_DATA(0x00); 
	TFT_SEND_DATA(0x00);		//end column
	TFT_SEND_DATA(0xEF);

	TFT_SEND_CMD(0x2b); 		//Row address set
	TFT_SEND_DATA(0x00); 		//start row
	TFT_SEND_DATA(0x00); 
	TFT_SEND_DATA(0x01);		//end row
	TFT_SEND_DATA(0x3F);
	  TFT_SEND_CMD(0x2C);			//Memory write
    for(ROW=0;ROW<OLED_LINE_NUMBER;ROW++)             //ROW loop
      { 
	  
	for(column=0;column<OLED_COLUMN_NUMBER ;column++)	//column loop
          {
            TFT_SEND_DATA(color>>16);
			  TFT_SEND_DATA(color>>8);
			  TFT_SEND_DATA(color);
          }
      }
  }
void OLED_init(void)				////ST7789V2
  {
	SPI_SCK_0;
	SPI_RST_0;
	delay_ms(1000);
	SPI_RST_1;
	delay_ms(1000);
    TFT_SEND_CMD(0x11); 			//Sleep Out
	delay_ms(120);               //DELAY120ms 
	//--------------------------------ST7789S Frame rate setting----------------------------------// 
	TFT_SEND_CMD(0x2a); 		//Column address set
	TFT_SEND_DATA(0x00); 		//start column
	TFT_SEND_DATA(0x00); 
	TFT_SEND_DATA(0x00);		//end column
	TFT_SEND_DATA(0xef);

	TFT_SEND_CMD(0x2b); 		//Row address set
	TFT_SEND_DATA(0x00); 		//start row
	TFT_SEND_DATA(0x28); 
	TFT_SEND_DATA(0x01);		//end row
	TFT_SEND_DATA(0x17);

	TFT_SEND_CMD(0xb2); 		//Porch control
	TFT_SEND_DATA(0x0c); 
	TFT_SEND_DATA(0x0c); 
	TFT_SEND_DATA(0x00); 
	TFT_SEND_DATA(0x33); 
	TFT_SEND_DATA(0x33); 

	TFT_SEND_CMD(0x20); 		//Display Inversion Off

	TFT_SEND_CMD(0xb7); 		//Gate control
	TFT_SEND_DATA(0x56);   		//35
//---------------------------------ST7789S Power setting--------------------------------------// 
	TFT_SEND_CMD(0xbb); //VCOMS Setting
	TFT_SEND_DATA(0x18);  //1f

	TFT_SEND_CMD(0xc0); 		//LCM Control
	TFT_SEND_DATA(0x2c); 

	TFT_SEND_CMD(0xc2); 		//VDV and VRH Command Enable
	TFT_SEND_DATA(0x01); 

	TFT_SEND_CMD(0xc3); //VRH Set
	TFT_SEND_DATA(0x1f); //12

	TFT_SEND_CMD(0xc4); 			//VDV Setting
	TFT_SEND_DATA(0x20); 

	TFT_SEND_CMD(0xc6); 			//FR Control 2
	TFT_SEND_DATA(0x0f); 
//TFT_SEND_CMD(0xca); 
//TFT_SEND_DATA(0x0f); 
//TFT_SEND_CMD(0xc8); 
//TFT_SEND_DATA(0x08); 
//TFT_SEND_CMD(0x55); 
//TFT_SEND_DATA(0x90); 
	TFT_SEND_CMD(0xd0);  //Power Control 1
	TFT_SEND_DATA(0xa6);   //a4
	TFT_SEND_DATA(0xa1); 
//--------------------------------ST7789S gamma setting---------------------------------------// 

	TFT_SEND_CMD(0xe0); 
	TFT_SEND_DATA(0xd0); 
	TFT_SEND_DATA(0x0d); 
	TFT_SEND_DATA(0x14); 
	TFT_SEND_DATA(0x0b); 
	TFT_SEND_DATA(0x0b); 
	TFT_SEND_DATA(0x07); 
	TFT_SEND_DATA(0x3a);  
	TFT_SEND_DATA(0x44); 
	TFT_SEND_DATA(0x50); 
	TFT_SEND_DATA(0x08); 
	TFT_SEND_DATA(0x13); 
	TFT_SEND_DATA(0x13); 
	TFT_SEND_DATA(0x2d); 
	TFT_SEND_DATA(0x32); 

	TFT_SEND_CMD(0xe1); 				//Negative Voltage Gamma Contro
	TFT_SEND_DATA(0xd0); 
	TFT_SEND_DATA(0x0d); 
	TFT_SEND_DATA(0x14); 
	TFT_SEND_DATA(0x0b); 
	TFT_SEND_DATA(0x0b); 
	TFT_SEND_DATA(0x07); 
	TFT_SEND_DATA(0x3a); 
	TFT_SEND_DATA(0x44); 
	TFT_SEND_DATA(0x50); 
	TFT_SEND_DATA(0x08); 
	TFT_SEND_DATA(0x13); 
	TFT_SEND_DATA(0x13); 
	TFT_SEND_DATA(0x2d); 
	TFT_SEND_DATA(0x32);
	
	TFT_SEND_CMD(0x36); 			//Memory data access control
	TFT_SEND_DATA(0x00); 
	
	TFT_SEND_CMD(0x3A); 			//Interface pixel format
	//TFT_SEND_DATA(0x55);			//65K	
	TFT_SEND_DATA(0x66);			//262K  RGB 6 6 6

	TFT_SEND_CMD(0xe7); 			//SPI2 enable    启用2数据通道模式
	TFT_SEND_DATA(0x00); 


	TFT_SEND_CMD(0x21);			//Display inversion on
	TFT_SEND_CMD(0x29); 			//Display on
	TFT_SEND_CMD(0x2C);			//Memory write
  }

void Picture_display(const unsigned char *ptr_pic)
  {
    unsigned int ROW,column;
	 TFT_SEND_CMD(0x2a); 		//Column address set
	TFT_SEND_DATA(0x00); 		//start column
	TFT_SEND_DATA(0x00); 
	TFT_SEND_DATA(0x00);		//end column
	TFT_SEND_DATA(0x63);

	TFT_SEND_CMD(0x2b); 		//Row address set
	TFT_SEND_DATA(0x00); 		//start row
	TFT_SEND_DATA(0x00); 
	TFT_SEND_DATA(0x00);		//end row
	TFT_SEND_DATA(0x63);
	  TFT_SEND_CMD(0x2C);			//Memory write
    for(ROW=0;ROW<100;ROW++)        //ROW loop
      {   
		
	for(column=0;column<100;column++)	//column loop
          {
            TFT_SEND_DATA(*ptr_pic++);
			TFT_SEND_DATA(*ptr_pic++);
			  TFT_SEND_DATA(*ptr_pic++);
          }
      }
  }
void display_char16_16(unsigned int x,unsigned int y,unsigned long color,const unsigned char *point)
{
	 unsigned int column;
	unsigned char tm=0,temp;
	 TFT_SEND_CMD(0x2a); 		//Column address set
	TFT_SEND_DATA(x>>8); 		//start column
	TFT_SEND_DATA(x);
	x=x+15;
	TFT_SEND_DATA(x>>8);		//end column
	TFT_SEND_DATA(x);

	TFT_SEND_CMD(0x2b); 		//Row address set
	TFT_SEND_DATA(y>>8); 		//start row
	TFT_SEND_DATA(y); 
	y=y+15;
	TFT_SEND_DATA(y>>8);		//end row
	TFT_SEND_DATA(y);
	  TFT_SEND_CMD(0x2C);			//Memory write
    
		
	for(column=0;column<32;column++)	//column loop
          {
			  temp=*point;
			  for(tm=0;tm<8;tm++)
			  {
			  if(temp&0x01)
					{
					TFT_SEND_DATA(color>>16);
					TFT_SEND_DATA(color>>8);
					TFT_SEND_DATA(color);
					}
			  else 
					{
					TFT_SEND_DATA(0);
					TFT_SEND_DATA(0);
					TFT_SEND_DATA(0);
					}
					temp>>=1;
				}
			  point++;
          
      }
}
void Picture_ReverseDisplay(const unsigned char *ptr_pic)
{
    unsigned int ROW,column,data;
	TFT_SEND_CMD(0x2a); 		//Column address set
	TFT_SEND_DATA(0x00); 		//start column
	TFT_SEND_DATA(0x00); 
	TFT_SEND_DATA(0x00);		//end column
	TFT_SEND_DATA(0xef);

	TFT_SEND_CMD(0x2b); 		//Row address set
	TFT_SEND_DATA(0x00); 		//start row
	TFT_SEND_DATA(0x28); 
	TFT_SEND_DATA(0x01);		//end row
	TFT_SEND_DATA(0x17);
	TFT_SEND_CMD(0x2C);			//Memory write
    for(ROW=0;ROW<OLED_LINE_NUMBER;ROW++)        //ROW loop
      { 
	  
	for(column=0;column<OLED_COLUMN_NUMBER;column++)	//column loop
          {
            data=*ptr_pic++;
            data=~data;
            TFT_SEND_DATA(data);
			
          }
      }
  }

int main(void)
{ 
	point= &picture_tab[0];
	SYS_init(4);
	IO_init();
	
	OLED_init();
	OLED_full(RED);
	delay_ms(1000);
	OLED_full(GREEN);
	delay_ms(1000);
	OLED_full(BLUE);
	delay_ms(1000);
	OLED_clear();
	while(1)
	{
		Picture_display(point);
		delay_ms(10000);
		display_char16_16(104,200,RED,china_char[0]);
		display_char16_16(120,200,GREEN,china_char[1]);
		display_char16_16(80,256,BLUE,china_char[2]);
		display_char16_16(96,256,0XFFFFFF,china_char[3]);
		display_char16_16(112,256,BLUE,china_char[4]);
		display_char16_16(138,256,GREEN,china_char[5]);
		display_char16_16(154,256,RED,china_char[6]);
		display_char16_16(96,280,BLUE,china_char[7]);
		display_char16_16(112,280,GREEN,china_char[8]);
		display_char16_16(138,280,RED,china_char[9]);
		display_char16_16(154,280,BLUE,china_char[10]);
		delay_ms(10000);
		OLED_clear();
//		Picture_ReverseDisplay(point);
//		delay_ms(10000);

	}
}
